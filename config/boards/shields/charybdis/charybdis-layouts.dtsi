/ {
    chosen {
        zmk,physical-layout = &charybdis_physical_layout;
    };

    key_physical_attrs: key_physical_attrs {
        compatible = "zmk,key-physical-attrs";
        #key-cells = <5>;
    };

    charybdis_physical_layout: charybdis_physical_layout {
        compatible = "zmk,physical-layout";
        display-name = "default transform";
        transform = <&default_transform>;
        kscan = <&kscan0>;

	keys  //                        x    y     rot    rx    ry
	    = <&key_physical_attrs    0    0       0     0     0>
	    , <&key_physical_attrs  100    0       0     0     0>
	    , <&key_physical_attrs  200    0       0     0     0>
	    , <&key_physical_attrs  300    0       0     0     0>
	    , <&key_physical_attrs  400    0       0     0     0>
	    , <&key_physical_attrs  500    0       0     0     0>
	    , <&key_physical_attrs  700    0       0     0     0>
	    , <&key_physical_attrs  800    0       0     0     0>
	    , <&key_physical_attrs  900    0       0     0     0>
	    , <&key_physical_attrs 1000    0       0     0     0>
	    , <&key_physical_attrs 1100    0       0     0     0>
	    , <&key_physical_attrs 1200    0       0     0     0>
	    , <&key_physical_attrs    0  100       0     0     0>
	    , <&key_physical_attrs  100  100       0     0     0>
	    , <&key_physical_attrs  200  100       0     0     0>
	    , <&key_physical_attrs  300  100       0     0     0>
	    , <&key_physical_attrs  400  100       0     0     0>
	    , <&key_physical_attrs  500  100       0     0     0>
	    , <&key_physical_attrs  700  100       0     0     0>
	    , <&key_physical_attrs  800  100       0     0     0>
	    , <&key_physical_attrs  900  100       0     0     0>
	    , <&key_physical_attrs 1000  100       0     0     0>
	    , <&key_physical_attrs 1100  100       0     0     0>
	    , <&key_physical_attrs 1200  100       0     0     0>
	    , <&key_physical_attrs    0  200       0     0     0>
	    , <&key_physical_attrs  100  200       0     0     0>
	    , <&key_physical_attrs  200  200       0     0     0>
	    , <&key_physical_attrs  300  200       0     0     0>
	    , <&key_physical_attrs  400  200       0     0     0>
	    , <&key_physical_attrs  500  200       0     0     0>
	    , <&key_physical_attrs  700  200       0     0     0>
	    , <&key_physical_attrs  800  200       0     0     0>
	    , <&key_physical_attrs  900  200       0     0     0>
	    , <&key_physical_attrs 1000  200       0     0     0>
	    , <&key_physical_attrs 1100  200       0     0     0>
	    , <&key_physical_attrs 1200  200       0     0     0>
	    , <&key_physical_attrs  300  300       0     0     0>
	    , <&key_physical_attrs  400  300       0     0     0>
	    , <&key_physical_attrs  500  300       0     0     0>
	    , <&key_physical_attrs  700  300       0     0     0>
	    , <&key_physical_attrs  800  300       0     0     0>
	    ;
    };
};
