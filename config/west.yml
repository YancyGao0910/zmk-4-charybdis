## config/west.yml
```yaml
manifest:
  remotes:
    - name: zmkfirmware
      url-base: https://github.com/zmkfirmware
    - name: YancyGao0910
      url-base: https://github.com/YancyGao0910
  projects:
    - name: zmk
      remote: zmkfirmware
      revision: main
      import: app/west.yml
    - name: zmk-pmw3610-driver
      remote: YancyGao0910
      revision: main
      
  self:
    path: config
```
